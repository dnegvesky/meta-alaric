## conf/layer.conf
```bitbake
# We have a conf and classes directory, append to BBPATH
BBPATH .= ":${LAYERDIR}"

# We have a recipes directory, add to BBFILES
BBFILES += "${LAYERDIR}/recipes*/*/*.bb \
            ${LAYERDIR}/recipes*/*/*.bbappend"

BBFILE_COLLECTIONS += "meta-alaric"
BBFILE_PATTERN_meta-alaric := "^${LAYERDIR}/"
# increase the number
BBFILE_PRIORITY_meta-alaric = "6"
LAYERDEPENDS_meta-alaric = "meta-altera"
```
